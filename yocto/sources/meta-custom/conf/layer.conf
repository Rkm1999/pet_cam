## yocto/sources/meta-custom/conf/layer.conf
```bitbake
# sources/meta-custom/conf/layer.conf
BBPATH.= ":${LAYERDIR}"
BBFILES += "${LAYERDIR}/recipes-*/*/*.bb \
            ${LAYERDIR}/recipes-*/*/*.bbappend"

BBFILE_COLLECTIONS += "custom"
BBFILE_PATTERN_custom = "^${LAYERDIR}/"
BBFILE_PRIORITY_custom = "10"
LAYERVERSION_custom = "1"
LAYERSERIES_COMPAT_custom = "scarthgap"
```
