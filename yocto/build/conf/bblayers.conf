## yocto/build/conf/bblayers.conf
```bitbake
# POKY_BBLAYERS_CONF_VERSION is increased each time build/conf/bblayers.conf
# changes incompatibly
POKY_BBLAYERS_CONF_VERSION = "2"

BBPATH = "${TOPDIR}"
BBFILES ?= ""

BBLAYERS ?= " \
  ${TOPDIR}/../sources/poky/meta \
  ${TOPDIR}/../sources/poky/meta-poky \
  ${TOPDIR}/../sources/poky/meta-yocto-bsp \
  "
BBLAYERS += "\
    ${TOPDIR}/../sources/meta-rockchip \
    ${TOPDIR}/../sources/meta-arm/meta-arm \
    ${TOPDIR}/../sources/meta-arm/meta-arm-toolchain \
    ${TOPDIR}/../sources/meta-openembedded/meta-oe \
${TOPDIR}/../sources/meta-custom\
"
```
